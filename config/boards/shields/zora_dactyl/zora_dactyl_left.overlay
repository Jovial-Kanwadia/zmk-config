#include "zora_dactyl.dtsi"

&kscan0 {
    // 1x1 Dummy Matrix for Testing
    col-gpios
        = <&gpio0 29 GPIO_ACTIVE_HIGH>
        ;

    row-gpios
        = <&gpio0 20 (GPIO_ACTIVE_HIGH | GPIO_PULL_DOWN)>
        ;
};
